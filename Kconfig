## Kconfig
```kconfig
menu "Display options"
    config DISPLAY_WIDTH
        int "Display width in pixels"
        default 1024
    config DISPLAY_HEIGHT
        int "Display height in pixels"
        default 600
    config DISPLAY_MARGIN_LEFT
        int "Left margin in pixels"
        default 120
    config DISPLAY_MARGIN_RIGHT
        int "Right margin in pixels"
        default 120
    config DISPLAY_MARGIN_TOP
        int "Top margin in pixels"
        default 0
    config DISPLAY_MARGIN_BOTTOM
        int "Bottom margin in pixels"
        default 0
    choice DISPLAY_ORIENTATION
        prompt "Display orientation"
        default DISPLAY_ORIENTATION_LANDSCAPE
        config DISPLAY_ORIENTATION_LANDSCAPE
            bool "Landscape"
        config DISPLAY_ORIENTATION_PORTRAIT
            bool "Portrait"
    endchoice
endmenu

menu "SD card options"
choice SDMMC_BUS_WIDTH
    prompt "SDMMC bus width"
    default SDMMC_BUS_WIDTH_1
    help
        Select the data bus width for the SDMMC host.
config SDMMC_BUS_WIDTH_1
    bool "1-bit mode"
config SDMMC_BUS_WIDTH_4
    bool "4-bit mode"
endchoice
endmenu
```

## Kconfig.projbuild
```kconfig
menu "Project configuration"

config MIN_BRIGHTNESS
    int "Minimum backlight brightness (%)"
    default 25
    range 0 100

config MAX_BRIGHTNESS
    int "Maximum backlight brightness (%)"
    default 100
    range 0 100

config WIFI_SSID
    string "WiFi SSID"
    default ""

config WIFI_PASSWORD
    string "WiFi Password"
    default ""

config WIFI_PROV_TIMEOUT_MS
    int "WiFi provisioning timeout (ms)"
    default 60000

config UPLOAD_MAX_BYTES
    int "Maximum upload size (bytes)"
    default 1048576

config UPLOAD_AUTH_TOKEN
    string "Upload Authorization token"
    default ""

endmenu
```

## main/Kconfig.projbuild
```kconfig
menu "Project configuration"

config MIN_BRIGHTNESS
    int "Minimum backlight brightness (%)"
    default 25
    range 0 100

config MAX_BRIGHTNESS
    int "Maximum backlight brightness (%)"
    default 100
    range 0 100

config BRIGHTNESS_HYSTERESIS
    int "Brightness change threshold (%)"
    default 5
    range 0 100

config BRIGHTNESS_GAMMA_X100
    int "Gamma correction factor (x100)"
    default 220
    range 1 1000

config BG_TASK_DELAY_MS
    int "Background task delay (ms)"
    default 1000

config WIFI_SSID
    string "WiFi SSID"
    default ""

config WIFI_PASSWORD
    string "WiFi Password"
    default ""

config WIFI_PROV_TIMEOUT_MS
    int "WiFi provisioning timeout (ms)"
    default 60000

config UPLOAD_MAX_BYTES
    int "Maximum upload size (bytes)"
    default 1048576

config UPLOAD_AUTH_TOKEN
    string "Upload Authorization token"
    default ""

endmenu


menu "Display options"
    config DISPLAY_WIDTH
        int "Display width in pixels"
        default 1024
    config DISPLAY_HEIGHT
        int "Display height in pixels"
        default 600
    config DISPLAY_MARGIN_LEFT
        int "Left margin in pixels"
        default 120
    config DISPLAY_MARGIN_RIGHT
        int "Right margin in pixels"
        default 120
    config DISPLAY_MARGIN_TOP
        int "Top margin in pixels"
        default 0
    config DISPLAY_MARGIN_BOTTOM
        int "Bottom margin in pixels"
        default 0
    choice DISPLAY_ORIENTATION
        prompt "Display orientation"
        default DISPLAY_ORIENTATION_LANDSCAPE
        config DISPLAY_ORIENTATION_LANDSCAPE
            bool "Landscape"
        config DISPLAY_ORIENTATION_PORTRAIT
            bool "Portrait"
    endchoice
endmenu

menu "Power management options"
    config INACTIVITY_TIMEOUT_MS
        int "Inactivity timeout before light sleep (ms)"
        default 60000
endmenu

menu "LCD panel options"
    config LCD_PIXEL_CLOCK_HZ
        int "Pixel clock frequency (Hz)"
        default 30000000

    config LCD_BIT_PER_PIXEL
        int "Bits per pixel"
        default 16

    config LCD_RGB_DATA_WIDTH
        int "RGB data width"
        default 16

    config LCD_RGB_BUFFER_NUMS
        int "Number of frame buffers"
        default 2

    config LCD_IO_RGB_DISP
        int "DISP GPIO number (-1 if unused)"
        default -1

    config LCD_IO_RGB_VSYNC
        int "VSYNC GPIO number"
        default 3

    config LCD_IO_RGB_HSYNC
        int "HSYNC GPIO number"
        default 46

    config LCD_IO_RGB_DE
        int "DE GPIO number"
        default 5

    config LCD_IO_RGB_PCLK
        int "PCLK GPIO number"
        default 7

    config LCD_IO_RGB_DATA0
        int "RGB DATA0 GPIO (B3)"
        default 14

    config LCD_IO_RGB_DATA1
        int "RGB DATA1 GPIO (B4)"
        default 38

    config LCD_IO_RGB_DATA2
        int "RGB DATA2 GPIO (B5)"
        default 18

    config LCD_IO_RGB_DATA3
        int "RGB DATA3 GPIO (B6)"
        default 17

    config LCD_IO_RGB_DATA4
        int "RGB DATA4 GPIO (B7)"
        default 10

    config LCD_IO_RGB_DATA5
        int "RGB DATA5 GPIO (G2)"
        default 39

    config LCD_IO_RGB_DATA6
        int "RGB DATA6 GPIO (G3)"
        default 0

    config LCD_IO_RGB_DATA7
        int "RGB DATA7 GPIO (G4)"
        default 45

    config LCD_IO_RGB_DATA8
        int "RGB DATA8 GPIO (G5)"
        default 48

    config LCD_IO_RGB_DATA9
        int "RGB DATA9 GPIO (G6)"
        default 47

    config LCD_IO_RGB_DATA10
        int "RGB DATA10 GPIO (G7)"
        default 21

    config LCD_IO_RGB_DATA11
        int "RGB DATA11 GPIO (R3)"
        default 1

    config LCD_IO_RGB_DATA12
        int "RGB DATA12 GPIO (R4)"
        default 2

    config LCD_IO_RGB_DATA13
        int "RGB DATA13 GPIO (R5)"
        default 42

    config LCD_IO_RGB_DATA14
        int "RGB DATA14 GPIO (R6)"
        default 41

    config LCD_IO_RGB_DATA15
        int "RGB DATA15 GPIO (R7)"
        default 40

    config LCD_IO_RST
        int "Reset GPIO number (-1 if unused)"
        default -1

    config LCD_PIN_NUM_BK_LIGHT
        int "Backlight GPIO number"
        default 16

    config LCD_BK_LIGHT_ON_LEVEL
        bool "Backlight active high"
        default y
endmenu

menu "SD card options"
    choice SDMMC_BUS_WIDTH
        prompt "SDMMC bus width"
        default SDMMC_BUS_WIDTH_1
        help
            Select the data bus width for the SDMMC host.
        config SDMMC_BUS_WIDTH_1
            bool "1-bit mode"
        config SDMMC_BUS_WIDTH_4
            bool "4-bit mode"
    endchoice
endmenu

menu "Network options"
    choice WIFI_PROV_TRANSPORT
        prompt "WiFi provisioning transport"
        default WIFI_PROV_TRANSPORT_SOFTAP
        config WIFI_PROV_TRANSPORT_BLE
            bool "BLE"
        config WIFI_PROV_TRANSPORT_SOFTAP
            bool "SoftAP"
    endchoice

    config IMAGE_FETCH_URL
        string "Remote BMP URL"
        default "http://example.com/image.bmp"
endmenu
```

## sdkconfig.defaults
```kconfig
CONFIG_IDF_TARGET="esp32s3"
CONFIG_ESP_DEFAULT_CPU_FREQ_MHZ_240=y
CONFIG_ESPTOOLPY_FLASHMODE_QIO=y
CONFIG_ESPTOOLPY_FLASHFREQ_80M=y
CONFIG_ESPTOOLPY_FLASHSIZE_8MB=y
CONFIG_SPIRAM=y
CONFIG_SPIRAM_MODE_OCT=y
CONFIG_IDF_EXPERIMENTAL_FEATURES=y
CONFIG_SPIRAM_SPEED_80M=y
CONFIG_SPIRAM_FETCH_INSTRUCTIONS=y
CONFIG_SPIRAM_RODATA=y

CONFIG_FREERTOS_HZ=1000
CONFIG_ESP32S3_DATA_CACHE_LINE_64B=y
CONFIG_COMPILER_OPTIMIZATION_PERF=y

CONFIG_FATFS_LFN_HEAP=y
CONFIG_SDMMC_BUS_WIDTH_1=y
CONFIG_DISPLAY_WIDTH=1024
CONFIG_DISPLAY_HEIGHT=600
CONFIG_DISPLAY_MARGIN_LEFT=120
CONFIG_DISPLAY_MARGIN_RIGHT=120
CONFIG_DISPLAY_MARGIN_TOP=0
CONFIG_DISPLAY_MARGIN_BOTTOM=0
CONFIG_DISPLAY_ORIENTATION_LANDSCAPE=y
# CONFIG_DISPLAY_ORIENTATION_PORTRAIT is not set
```
